## boards/mcxn947_breakout/board.yml
```yaml
board:
  name: mcxn947_breakoutcard
  full_name: buns
  vendor: nxp
  socs:
    - name: mcxn947
```

## boards/mcxn947_protocard/board.yml
```yaml
board:
  name: mcxn947_protocard
  full_name: balls
  vendor: nxp
  socs:
    - name: mcxn947
```
